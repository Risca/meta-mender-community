## meta-mender-chip/conf/layer.conf
```bitbake
# We have a conf and classes directory, add to BBPATH
BBPATH .= ":${LAYERDIR}"

# We have recipes-* directories, add to BBFILES
BBFILES += "${LAYERDIR}/recipes-*/*/*.bb \
	${LAYERDIR}/recipes-*/*/*.bbappend"

BBFILE_COLLECTIONS += "mender-chip"
BBFILE_PATTERN_mender-chip = "^${LAYERDIR}/"
BBFILE_PRIORITY_mender-chip = "10"

LAYERSERIES_COMPAT_mender-chip = "kirkstone"
```
